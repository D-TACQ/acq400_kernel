// SPDX-License-Identifier: GPL-2.0
/dts-v1/;
/plugin/;	/* allow undefined label references and record them */

/ {
	fragment@0 {
		target = <&spi0>;
		__overlay__ {
			#address-cells = <1>;
			#size-cells = <0>;			
			status = "okay";

			acq428_6: acq428spi@60{
				reg = <0x60>;
				spi-max-frequency = <10000000>;
				compatible = "rohm,dh2228fv";
			};
		};
	};
};
